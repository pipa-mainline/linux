// SPDX-License-Identifier: BSD-3-Clause
/*
 * Copyright (c) 2023, The Linux Foundation. All rights reserved.
 */

#include "sm8250.dtsi"

&cpu7_opp_table {
	cpu7_opp21: opp-3187200000 {
		opp-hz = /bits/ 64 <3187200000>;
		opp-peak-kBps = <8368000 51609600>;
	};
};
